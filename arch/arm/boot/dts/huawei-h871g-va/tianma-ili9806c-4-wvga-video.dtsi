/* Copyright (c) 2013, The Linux Foundation. All rights reserved.
 *
 * This program is free software; you can redistribute it and/or modify
 * it under the terms of the GNU General Public License version 2 and
 * only version 2 as published by the Free Software Foundation.
 *
 * This program is distributed in the hope that it will be useful,
 * but WITHOUT ANY WARRANTY; without even the implied warranty of
 * MERCHANTABILITY or FITNESS FOR A PARTICULAR PURPOSE.  See the
 * GNU General Public License for more details.
 */

/*---------------------------------------------------------------------------
 * This file is autogenerated file using gcdb parser. Please do not edit it.
 * Update input XML file to add a new entry or update variable in this file
 * VERSION = "1.0"
 *---------------------------------------------------------------------------*/
&mdss_mdp {
	dsi_tianma_ili9806c_4_wvga_video: qcom,mdss_dsi_tianma_ili9806c_4_wvga_video {
		qcom,mdss-dsi-panel-name = "TIANMA_ILI9806C_WVGA_VIDEO";
		qcom,cont-splash-enabled;
		qcom,mdss-dsi-panel-controller = <&mdss_dsi0>;
		qcom,mdss-dsi-panel-type = "dsi_video_mode";
		qcom,mdss-dsi-panel-destination = "display_1";
		qcom,mdss-dsi-panel-framerate = <60>;
		qcom,mdss-dsi-virtual-channel-id = <0>;
		qcom,mdss-dsi-stream = <0>;
		qcom,mdss-dsi-panel-width = <480>;
		qcom,mdss-dsi-panel-height = <801>;
		qcom,mdss-dsi-h-front-porch = <80>;
		qcom,mdss-dsi-h-back-porch = <80>;
		qcom,mdss-dsi-h-pulse-width = <8>;
		qcom,mdss-dsi-h-sync-skew = <0>;
		qcom,mdss-dsi-v-back-porch = <17>;
		qcom,mdss-dsi-v-front-porch = <17>;
		qcom,mdss-dsi-v-pulse-width = <3>;
		qcom,mdss-dsi-h-left-border = <0>;
		qcom,mdss-dsi-h-right-border = <0>;
		qcom,mdss-dsi-v-top-border = <0>;
		qcom,mdss-dsi-v-bottom-border = <0>;
		qcom,mdss-dsi-bpp = <24>;
		qcom,mdss-dsi-color-order = <0>;
		qcom,mdss-dsi-underflow-color = <0xff>;
		qcom,mdss-dsi-border-color = <0>;
		qcom,mdss-dsi-on-command = [	29 01 00 00 00 00 04 FF FF 98 16
			29 01 00 00 00 00 02 F3 70
			29 01 00 00 00 00 13 BC 01 0F 00 00 16 16 0B 11 34 00 00 00 0A 0A 00 00 50 52
			29 01 00 00 00 00 09 BD 01 23 45 67 01 23 45 67
			29 01 00 00 00 00 12 BE 13 11 00 22 22 22 22 AA BB 66 22 22 22 22 22 22 22
			29 01 00 00 00 00 11 E0 00 03 0B 0E 10 16 7A 09 04 08 07 0D 0D 31 2C 00
			29 01 00 00 00 00 11 E1 00 03 0B 0E 10 16 7A 09 04 08 06 0D 0D 31 2C 00			
			29 01 00 00 00 00 03 ED 7F 0F
			29 01 00 00 00 00 02 B4 00
			29 01 00 00 00 00 09 D5 09 0B 0D 0B CB A5 01 04
			29 01 00 00 00 00 04 C0 0F 0B 04
			29 01 00 00 00 00 02 D8 26
			29 01 00 00 00 00 05 C1 17 78 78 20
			29 01 00 00 00 00 02 C7 80
			29 01 00 00 00 00 02 C8 02
			29 01 00 00 00 00 02 F7 8A
			29 01 00 00 00 00 04 F9 04 F9 80
			15 01 00 00 00 00 02 51 00
			15 01 00 00 00 00 02 53 24
			15 01 00 00 00 00 02 55 01
			05 01 00 00 78 00 02 11 00
			05 01 00 00 14 00 02 29 00 ];
		qcom,mdss-dsi-off-command = [05 01 00 00 14 00 02 28 00
					05 01 00 00 78 00 02 10 00];
		qcom,mdss-dsi-on-command-state = "dsi_lp_mode";
		qcom,mdss-dsi-off-command-state = "dsi_hs_mode";
		qcom,mdss-dsi-h-sync-pulse = <1>;
		qcom,mdss-dsi-traffic-mode = "burst_mode";
		qcom,mdss-dsi-lane-map = "lane_map_3012";
		qcom,mdss-dsi-bllp-eof-power-mode;
		qcom,mdss-dsi-bllp-power-mode;
		qcom,mdss-dsi-lane-0-state;
		qcom,mdss-dsi-lane-1-state;
		qcom,mdss-dsi-panel-timings = [72 19 10 00 3C 3F 17 1C 1B 03 04 00];
		qcom,mdss-dsi-reset-sequence = <1 1>, <0 20>, <1 120>;
		qcom,mdss-dsi-t-clk-post = <0x04>;
		qcom,mdss-dsi-t-clk-pre = <0x19>;
		qcom,mdss-dsi-bl-min-level = <1>;
		qcom,mdss-dsi-bl-max-level = <255>;
		qcom,mdss-dsi-dma-trigger = "trigger_sw";
		qcom,mdss-dsi-mdp-trigger = "none";
		qcom,mdss-dsi-bl-pmic-control-type = "bl_ctrl_dcs";
		qcom,panel-inverse-off-cmds = [05 01 00 00 00 00 02 20 00];
		qcom,panel-inverse-on-cmds = [05 01 00 00 00 00 02 21 00];
		qcom,inverse-on-cmds-dsi-state = "dsi_lp_mode";
		qcom,inverse-off-cmds-dsi-state = "dsi_lp_mode";
		qcom,panel-cabc-ui-cmds = [15 01 00 00 00 00 02 55 01
					15 01 00 00 00 00 02 53 24];
		qcom,panel-cabc-video-cmds = [15 01 00 00 00 00 02 55 03
					15 01 00 00 00 00 02 53 2C];
		qcom,panel-dot-inversion-mode-cmds = [29 01 00 00 00 00 02 B4 02];
		qcom,panel-column-inversion-mode-cmds = [29 01 00 00 00 00 02 B4 00];
		qcom,cabc-ui-cmds-dsi-state = "dsi_hs_mode";
		qcom,cabc-video-cmds-dsi-state = "dsi_hs_mode";
		qcom,dot-inversion-cmds-dsi-state = "dsi_hs_mode";
		qcom,column-inversion-cmds-dsi-state = "dsi_hs_mode";
		huawei,delaytime-before-bl = <80>;
		huawei,power-down-bkl-flag;
	};
};
