/* Copyright (c) 2013, The Linux Foundation. All rights reserved.
 *
 * This program is free software; you can redistribute it and/or modify
 * it under the terms of the GNU General Public License version 2 and
 * only version 2 as published by the Free Software Foundation.
 *
 * This program is distributed in the hope that it will be useful,
 * but WITHOUT ANY WARRANTY; without even the implied warranty of
 * MERCHANTABILITY or FITNESS FOR A PARTICULAR PURPOSE.  See the
 * GNU General Public License for more details.
 */

/*---------------------------------------------------------------------------
 * This file is autogenerated file using gcdb parser. Please do not edit it.
 * Update input XML file to add a new entry or update variable in this file
 * VERSION = "1.0"
 *---------------------------------------------------------------------------*/
&mdss_mdp {
	dsi_tianma_nt35592_5_720p_video: qcom,mdss_dsi_tianma_nt35592_5_720p_video {
		qcom,mdss-dsi-panel-name = "TIANMA_NT35592_5_720P_VIDEO";
		qcom,cont-splash-enabled;
		qcom,mdss-dsi-panel-controller = <&mdss_dsi0>;
		qcom,mdss-dsi-panel-type = "dsi_video_mode";
		qcom,mdss-dsi-panel-destination = "display_1";
		qcom,mdss-dsi-panel-framerate = <60>;
		qcom,mdss-dsi-virtual-channel-id = <0>;
		qcom,mdss-dsi-stream = <0>;
		qcom,mdss-dsi-panel-width = <720>;
		qcom,mdss-dsi-panel-height = <1280>;
		qcom,mdss-dsi-h-front-porch = <92>;
		qcom,mdss-dsi-h-back-porch = <92>;
		qcom,mdss-dsi-h-pulse-width = <12>;
		qcom,mdss-dsi-h-sync-skew = <0>;
		qcom,mdss-dsi-v-back-porch = <16>;
		qcom,mdss-dsi-v-front-porch = <12>;
		qcom,mdss-dsi-v-pulse-width = <5>;
		qcom,mdss-dsi-h-left-border = <0>;
		qcom,mdss-dsi-h-right-border = <0>;
		qcom,mdss-dsi-v-top-border = <0>;
		qcom,mdss-dsi-v-bottom-border = <0>;
		qcom,mdss-dsi-bpp = <24>;
		qcom,mdss-dsi-color-order = <0>;
		qcom,mdss-dsi-underflow-color = <0xff>;
		qcom,mdss-dsi-border-color = <0>;
		qcom,mdss-dsi-on-command = [29 01 00 00 00 00 02 FF 00
			29 01 00 00 00 00 02 FB 01
			29 01 00 00 00 00 02 FF 01
			29 01 00 00 00 00 02 FB 01
			29 01 00 00 00 00 02 00 3A
			29 01 00 00 00 00 02 01 33
			29 01 00 00 00 00 02 02 53
			29 01 00 00 00 00 02 03 53
			29 01 00 00 00 00 02 04 55
			29 01 00 00 00 00 02 05 33
			29 01 00 00 00 00 02 06 22
			29 01 00 00 00 00 02 08 16
			29 01 00 00 00 00 02 09 8F
			29 01 00 00 00 00 02 0B A7
			29 01 00 00 00 00 02 0C A7
			29 01 00 00 00 00 02 0D 2E
			29 01 00 00 00 00 02 0E 33
			29 01 00 00 00 00 02 71 2C
			29 01 00 00 00 00 02 0F 0A
			29 01 00 00 00 00 02 36 73
			29 01 00 00 00 00 02 FF 05
			29 01 00 00 00 00 02 FB 01
			29 01 00 00 00 00 02 01 00
			29 01 00 00 00 00 02 02 8D
			29 01 00 00 00 00 02 03 8D
			29 01 00 00 00 00 02 04 8D
			29 01 00 00 00 00 02 05 30
			29 01 00 00 00 00 02 06 33
			29 01 00 00 00 00 02 07 77
			29 01 00 00 00 00 02 08 00
			29 01 00 00 00 00 02 09 00
			29 01 00 00 00 00 02 0A 00
			29 01 00 00 00 00 02 0B 80
			29 01 00 00 00 00 02 0C C8
			29 01 00 00 00 00 02 0D 0A
			29 01 00 00 00 00 02 0E 1B
			29 01 00 00 00 00 02 0F 06
			29 01 00 00 00 00 02 10 56
			29 01 00 00 00 00 02 11 00
			29 01 00 00 00 00 02 12 00
			29 01 00 00 00 00 02 13 1E
			29 01 00 00 00 00 02 14 00
			29 01 00 00 00 00 02 15 1A
			29 01 00 00 00 00 02 16 05
			29 01 00 00 00 00 02 17 00
			29 01 00 00 00 00 02 18 1E
			29 01 00 00 00 00 02 19 FF
			29 01 00 00 00 00 02 1A 00
			29 01 00 00 00 00 02 1B FC
			29 01 00 00 00 00 02 1C 80
			29 01 00 00 00 00 02 1D 00
			29 01 00 00 00 00 02 1E 00
			29 01 00 00 00 00 02 1F 77
			29 01 00 00 00 00 02 20 00
			29 01 00 00 00 00 02 21 00
			29 01 00 00 00 00 02 22 55
			29 01 00 00 00 00 02 23 0D
			29 01 00 00 00 00 02 6C 03
			29 01 00 00 00 00 02 6D 03
			29 01 00 00 00 00 02 31 A0
			29 01 00 00 00 00 02 32 00
			29 01 00 00 00 00 02 33 B8
			29 01 00 00 00 00 02 34 BB
			29 01 00 00 00 00 02 35 11
			29 01 00 00 00 00 02 36 02
			29 01 00 00 00 00 02 37 00
			29 01 00 00 00 00 02 38 01
			29 01 00 00 00 00 02 39 0B
			29 01 00 00 00 00 02 44 08
			29 01 00 00 00 00 02 45 80
			29 01 00 00 00 00 02 46 CC
			29 01 00 00 00 00 02 47 04
			29 01 00 00 00 00 02 48 00
			29 01 00 00 00 00 02 49 00
			29 01 00 00 00 00 02 4A 01
			29 01 00 00 00 00 02 6C 03
			29 01 00 00 00 00 02 6D 03
			29 01 00 00 00 00 02 6E 2F
			29 01 00 00 00 00 02 43 00
			29 01 00 00 00 00 02 4B 23
			29 01 00 00 00 00 02 4C 01
			29 01 00 00 00 00 02 50 23
			29 01 00 00 00 00 02 51 01
			29 01 00 00 00 00 02 58 23
			29 01 00 00 00 00 02 59 01
			29 01 00 00 00 00 02 5D 23
			29 01 00 00 00 00 02 5E 01
			29 01 00 00 00 00 02 89 00
			29 01 00 00 00 00 02 8D 01
			29 01 00 00 00 00 02 8E 64
			29 01 00 00 00 00 02 8F 20
			29 01 00 00 00 00 02 97 8E
			29 01 00 00 00 00 02 82 8C
			29 01 00 00 00 00 02 83 02
			29 01 00 00 00 00 02 BB 0A
			29 01 00 00 00 00 02 BC 0A
			29 01 00 00 00 00 02 24 25
			29 01 00 00 00 00 02 25 55
			29 01 00 00 00 00 02 26 05
			29 01 00 00 00 00 02 27 23
			29 01 00 00 00 00 02 28 01
			29 01 00 00 00 00 02 29 31
			29 01 00 00 00 00 02 2A 5D
			29 01 00 00 00 00 02 2B 01
			29 01 00 00 00 00 02 2F 00
			29 01 00 00 00 00 02 30 10
			29 01 00 00 00 00 02 A7 12
			29 01 00 00 00 00 02 2D 03
			29 01 00 00 00 00 02 FF 01
			29 01 00 00 00 00 02 FB 01
			29 01 00 00 00 00 02 75 00
			29 01 00 00 00 00 02 76 35
			29 01 00 00 00 00 02 77 00
			29 01 00 00 00 00 02 78 51
			29 01 00 00 00 00 02 79 00
			29 01 00 00 00 00 02 7A 78
			29 01 00 00 00 00 02 7B 00
			29 01 00 00 00 00 02 7C 97
			29 01 00 00 00 00 02 7D 00
			29 01 00 00 00 00 02 7E AF
			29 01 00 00 00 00 02 7F 00
			29 01 00 00 00 00 02 80 C0
			29 01 00 00 00 00 02 81 00
			29 01 00 00 00 00 02 82 C7
			29 01 00 00 00 00 02 83 00
			29 01 00 00 00 00 02 84 D6
			29 01 00 00 00 00 02 85 00
			29 01 00 00 00 00 02 86 E6
			29 01 00 00 00 00 02 87 01
			29 01 00 00 00 00 02 88 16
			29 01 00 00 00 00 02 89 01
			29 01 00 00 00 00 02 8A 3D
			29 01 00 00 00 00 02 8B 01
			29 01 00 00 00 00 02 8C 75
			29 01 00 00 00 00 02 8D 01
			29 01 00 00 00 00 02 8E A3
			29 01 00 00 00 00 02 8F 01
			29 01 00 00 00 00 02 90 EB
			29 01 00 00 00 00 02 91 02
			29 01 00 00 00 00 02 92 27
			29 01 00 00 00 00 02 93 02
			29 01 00 00 00 00 02 94 29
			29 01 00 00 00 00 02 95 02
			29 01 00 00 00 00 02 96 5F
			29 01 00 00 00 00 02 97 02
			29 01 00 00 00 00 02 98 99
			29 01 00 00 00 00 02 99 02
			29 01 00 00 00 00 02 9A BE
			29 01 00 00 00 00 02 9B 02
			29 01 00 00 00 00 02 9C F2
			29 01 00 00 00 00 02 9D 03
			29 01 00 00 00 00 02 9E 11
			29 01 00 00 00 00 02 9F 03
			29 01 00 00 00 00 02 A0 3F
			29 01 00 00 00 00 02 A2 03
			29 01 00 00 00 00 02 A3 49
			29 01 00 00 00 00 02 A4 03
			29 01 00 00 00 00 02 A5 57
			29 01 00 00 00 00 02 A6 03
			29 01 00 00 00 00 02 A7 6B
			29 01 00 00 00 00 02 A9 03
			29 01 00 00 00 00 02 AA 7C
			29 01 00 00 00 00 02 AB 03
			29 01 00 00 00 00 02 AC 92
			29 01 00 00 00 00 02 AD 03
			29 01 00 00 00 00 02 AE AA
			29 01 00 00 00 00 02 AF 03
			29 01 00 00 00 00 02 B0 D9
			29 01 00 00 00 00 02 B1 03
			29 01 00 00 00 00 02 B2 DB
			29 01 00 00 00 00 02 B3 00
			29 01 00 00 00 00 02 B4 35
			29 01 00 00 00 00 02 B5 00
			29 01 00 00 00 00 02 B6 51
			29 01 00 00 00 00 02 B7 00
			29 01 00 00 00 00 02 B8 78
			29 01 00 00 00 00 02 B9 00
			29 01 00 00 00 00 02 BA 97
			29 01 00 00 00 00 02 BB 00
			29 01 00 00 00 00 02 BC AF
			29 01 00 00 00 00 02 BD 00
			29 01 00 00 00 00 02 BE C0
			29 01 00 00 00 00 02 BF 00
			29 01 00 00 00 00 02 C0 C7
			29 01 00 00 00 00 02 C1 00
			29 01 00 00 00 00 02 C2 D6
			29 01 00 00 00 00 02 C3 00
			29 01 00 00 00 00 02 C4 E6
			29 01 00 00 00 00 02 C5 01
			29 01 00 00 00 00 02 C6 16
			29 01 00 00 00 00 02 C7 01
			29 01 00 00 00 00 02 C8 3D
			29 01 00 00 00 00 02 C9 01
			29 01 00 00 00 00 02 CA 75
			29 01 00 00 00 00 02 CB 01
			29 01 00 00 00 00 02 CC A3
			29 01 00 00 00 00 02 CD 01
			29 01 00 00 00 00 02 CE EB
			29 01 00 00 00 00 02 CF 02
			29 01 00 00 00 00 02 D0 27
			29 01 00 00 00 00 02 D1 02
			29 01 00 00 00 00 02 D2 29
			29 01 00 00 00 00 02 D3 02
			29 01 00 00 00 00 02 D4 5F
			29 01 00 00 00 00 02 D5 02
			29 01 00 00 00 00 02 D6 99
			29 01 00 00 00 00 02 D7 02
			29 01 00 00 00 00 02 D8 BE
			29 01 00 00 00 00 02 D9 02
			29 01 00 00 00 00 02 DA F2
			29 01 00 00 00 00 02 DB 03
			29 01 00 00 00 00 02 DC 11
			29 01 00 00 00 00 02 DD 03
			29 01 00 00 00 00 02 DE 3F
			29 01 00 00 00 00 02 DF 03
			29 01 00 00 00 00 02 E0 49
			29 01 00 00 00 00 02 E1 03
			29 01 00 00 00 00 02 E2 57
			29 01 00 00 00 00 02 E3 03
			29 01 00 00 00 00 02 E4 6B
			29 01 00 00 00 00 02 E5 03
			29 01 00 00 00 00 02 E6 7C
			29 01 00 00 00 00 02 E7 03
			29 01 00 00 00 00 02 E8 92
			29 01 00 00 00 00 02 E9 03
			29 01 00 00 00 00 02 EA AA
			29 01 00 00 00 00 02 EB 03
			29 01 00 00 00 00 02 EC D9
			29 01 00 00 00 00 02 ED 03
			29 01 00 00 00 00 02 EE DB
			29 01 00 00 00 00 02 EF 00
			29 01 00 00 00 00 02 F0 35
			29 01 00 00 00 00 02 F1 00
			29 01 00 00 00 00 02 F2 51
			29 01 00 00 00 00 02 F3 00
			29 01 00 00 00 00 02 F4 78
			29 01 00 00 00 00 02 F5 00
			29 01 00 00 00 00 02 F6 97
			29 01 00 00 00 00 02 F7 00
			29 01 00 00 00 00 02 F8 AF
			29 01 00 00 00 00 02 F9 00
			29 01 00 00 00 00 02 FA C0
			29 01 00 00 00 00 02 FF 00
			29 01 00 00 00 00 02 FF 02
			29 01 00 00 00 00 02 FB 01
			29 01 00 00 00 00 02 00 00
			29 01 00 00 00 00 02 01 C7
			29 01 00 00 00 00 02 02 00
			29 01 00 00 00 00 02 03 D6
			29 01 00 00 00 00 02 04 00
			29 01 00 00 00 00 02 05 E6
			29 01 00 00 00 00 02 06 01
			29 01 00 00 00 00 02 07 16
			29 01 00 00 00 00 02 08 01
			29 01 00 00 00 00 02 09 3D
			29 01 00 00 00 00 02 0A 01
			29 01 00 00 00 00 02 0B 75
			29 01 00 00 00 00 02 0C 01
			29 01 00 00 00 00 02 0D A3
			29 01 00 00 00 00 02 0E 01
			29 01 00 00 00 00 02 0F EB
			29 01 00 00 00 00 02 10 02
			29 01 00 00 00 00 02 11 27
			29 01 00 00 00 00 02 12 02
			29 01 00 00 00 00 02 13 29
			29 01 00 00 00 00 02 14 02
			29 01 00 00 00 00 02 15 5F
			29 01 00 00 00 00 02 16 02
			29 01 00 00 00 00 02 17 99
			29 01 00 00 00 00 02 18 02
			29 01 00 00 00 00 02 19 BE
			29 01 00 00 00 00 02 1A 02
			29 01 00 00 00 00 02 1B F2
			29 01 00 00 00 00 02 1C 03
			29 01 00 00 00 00 02 1D 11
			29 01 00 00 00 00 02 1E 03
			29 01 00 00 00 00 02 1F 3F
			29 01 00 00 00 00 02 20 03
			29 01 00 00 00 00 02 21 49
			29 01 00 00 00 00 02 22 03
			29 01 00 00 00 00 02 23 57
			29 01 00 00 00 00 02 24 03
			29 01 00 00 00 00 02 25 6B
			29 01 00 00 00 00 02 26 03
			29 01 00 00 00 00 02 27 7C
			29 01 00 00 00 00 02 28 03
			29 01 00 00 00 00 02 29 92
			29 01 00 00 00 00 02 2A 03
			29 01 00 00 00 00 02 2B AA
			29 01 00 00 78 00 02 2D 03
			29 01 00 00 00 00 02 2F D9
			29 01 00 00 00 00 02 30 03
			29 01 00 00 00 00 02 31 DB
			29 01 00 00 00 00 02 32 00
			29 01 00 00 00 00 02 33 35
			29 01 00 00 00 00 02 34 00
			29 01 00 00 00 00 02 35 51
			29 01 00 00 00 00 02 36 00
			29 01 00 00 00 00 02 37 78
			29 01 00 00 00 00 02 38 00
			29 01 00 00 00 00 02 39 97
			29 01 00 00 00 00 02 3A 00
			29 01 00 00 00 00 02 3B AF
			29 01 00 00 00 00 02 3D 00
			29 01 00 00 00 00 02 3F C0
			29 01 00 00 00 00 02 40 00
			29 01 00 00 00 00 02 41 C7
			29 01 00 00 00 00 02 42 00
			29 01 00 00 00 00 02 43 D6
			29 01 00 00 00 00 02 44 00
			29 01 00 00 00 00 02 45 E6
			29 01 00 00 00 00 02 46 01
			29 01 00 00 00 00 02 47 16
			29 01 00 00 00 00 02 48 01
			29 01 00 00 00 00 02 49 3D
			29 01 00 00 00 00 02 4A 01
			29 01 00 00 00 00 02 4B 75
			29 01 00 00 00 00 02 4C 01
			29 01 00 00 00 00 02 4D A3
			29 01 00 00 00 00 02 4E 01
			29 01 00 00 00 00 02 4F EB
			29 01 00 00 00 00 02 50 02
			29 01 00 00 00 00 02 51 27
			29 01 00 00 00 00 02 52 02
			29 01 00 00 00 00 02 53 29
			29 01 00 00 00 00 02 54 02
			29 01 00 00 00 00 02 55 5F
			29 01 00 00 00 00 02 56 02
			29 01 00 00 00 00 02 58 99
			29 01 00 00 00 00 02 59 02
			29 01 00 00 00 00 02 5A BE
			29 01 00 00 00 00 02 5B 02
			29 01 00 00 00 00 02 5C F2
			29 01 00 00 00 00 02 5D 03
			29 01 00 00 00 00 02 5E 11
			29 01 00 00 00 00 02 5F 03
			29 01 00 00 00 00 02 60 3F
			29 01 00 00 00 00 02 61 03
			29 01 00 00 00 00 02 62 49
			29 01 00 00 00 00 02 63 03
			29 01 00 00 00 00 02 64 57
			29 01 00 00 00 00 02 65 03
			29 01 00 00 00 00 02 66 6B
			29 01 00 00 00 00 02 67 03
			29 01 00 00 00 00 02 68 7C
			29 01 00 00 00 00 02 69 03
			29 01 00 00 00 00 02 6A 92
			29 01 00 00 00 00 02 6B 03
			29 01 00 00 00 00 02 6C AA
			29 01 00 00 00 00 02 6D 03
			29 01 00 00 00 00 02 6E D9
			29 01 00 00 00 00 02 6F 03
			29 01 00 00 00 00 02 70 DB
			29 01 00 00 00 00 02 71 00
			29 01 00 00 00 00 02 72 35
			29 01 00 00 00 00 02 73 00
			29 01 00 00 00 00 02 74 51
			29 01 00 00 00 00 02 75 00
			29 01 00 00 00 00 02 76 78
			29 01 00 00 00 00 02 77 00
			29 01 00 00 00 00 02 78 97
			29 01 00 00 00 00 02 79 00
			29 01 00 00 00 00 02 7A AF
			29 01 00 00 00 00 02 7B 00
			29 01 00 00 00 00 02 7C C0
			29 01 00 00 00 00 02 7D 00
			29 01 00 00 00 00 02 7E C7
			29 01 00 00 00 00 02 7F 00
			29 01 00 00 00 00 02 80 D6
			29 01 00 00 00 00 02 81 00
			29 01 00 00 00 00 02 82 E6
			29 01 00 00 00 00 02 83 01
			29 01 00 00 00 00 02 84 16
			29 01 00 00 00 00 02 85 01
			29 01 00 00 00 00 02 86 3D
			29 01 00 00 00 00 02 87 01
			29 01 00 00 00 00 02 88 75
			29 01 00 00 00 00 02 89 01
			29 01 00 00 00 00 02 8A A3
			29 01 00 00 00 00 02 8B 01
			29 01 00 00 00 00 02 8C EB
			29 01 00 00 00 00 02 8D 02
			29 01 00 00 00 00 02 8E 27
			29 01 00 00 00 00 02 8F 02
			29 01 00 00 00 00 02 90 29
			29 01 00 00 00 00 02 91 02
			29 01 00 00 00 00 02 92 5F
			29 01 00 00 00 00 02 93 02
			29 01 00 00 00 00 02 94 99
			29 01 00 00 00 00 02 95 02
			29 01 00 00 00 00 02 96 BE
			29 01 00 00 00 00 02 97 02
			29 01 00 00 00 00 02 98 F2
			29 01 00 00 00 00 02 99 03
			29 01 00 00 00 00 02 9A 11
			29 01 00 00 00 00 02 9B 03
			29 01 00 00 00 00 02 9C 3F
			29 01 00 00 00 00 02 9D 03
			29 01 00 00 00 00 02 9E 49
			29 01 00 00 00 00 02 9F 03
			29 01 00 00 00 00 02 A0 57
			29 01 00 00 00 00 02 A2 03
			29 01 00 00 00 00 02 A3 6B
			29 01 00 00 00 00 02 A4 03
			29 01 00 00 00 00 02 A5 7C
			29 01 00 00 00 00 02 A6 03
			29 01 00 00 00 00 02 A7 92
			29 01 00 00 00 00 02 A9 03
			29 01 00 00 00 00 02 AA AA
			29 01 00 00 00 00 02 AB 03
			29 01 00 00 00 00 02 AC D9
			29 01 00 00 00 00 02 AD 03
			29 01 00 00 00 00 02 AE DB
			29 01 00 00 00 00 02 AF 00
			29 01 00 00 00 00 02 B0 35
			29 01 00 00 00 00 02 B1 00
			29 01 00 00 00 00 02 B2 51
			29 01 00 00 00 00 02 B3 00
			29 01 00 00 00 00 02 B4 78
			29 01 00 00 00 00 02 B5 00
			29 01 00 00 00 00 02 B6 97
			29 01 00 00 00 00 02 B7 00
			29 01 00 00 00 00 02 B8 AF
			29 01 00 00 00 00 02 B9 00
			29 01 00 00 00 00 02 BA C0
			29 01 00 00 00 00 02 BB 00
			29 01 00 00 00 00 02 BC C7
			29 01 00 00 00 00 02 BD 00
			29 01 00 00 00 00 02 BE D6
			29 01 00 00 00 00 02 BF 00
			29 01 00 00 00 00 02 C0 E6
			29 01 00 00 00 00 02 C1 01
			29 01 00 00 00 00 02 C2 16
			29 01 00 00 00 00 02 C3 01
			29 01 00 00 00 00 02 C4 3D
			29 01 00 00 00 00 02 C5 01
			29 01 00 00 00 00 02 C6 75
			29 01 00 00 00 00 02 C7 01
			29 01 00 00 00 00 02 C8 A3
			29 01 00 00 00 00 02 C9 01
			29 01 00 00 00 00 02 CA EB
			29 01 00 00 00 00 02 CB 02
			29 01 00 00 00 00 02 CC 27
			29 01 00 00 00 00 02 CD 02
			29 01 00 00 00 00 02 CE 29
			29 01 00 00 00 00 02 CF 02
			29 01 00 00 00 00 02 D0 5F
			29 01 00 00 00 00 02 D1 02
			29 01 00 00 00 00 02 D2 99
			29 01 00 00 00 00 02 D3 02
			29 01 00 00 00 00 02 D4 BE
			29 01 00 00 00 00 02 D5 02
			29 01 00 00 00 00 02 D6 F2
			29 01 00 00 00 00 02 D7 03
			29 01 00 00 00 00 02 D8 11
			29 01 00 00 00 00 02 D9 03
			29 01 00 00 00 00 02 DA 3F
			29 01 00 00 00 00 02 DB 03
			29 01 00 00 00 00 02 DC 49
			29 01 00 00 00 00 02 DD 03
			29 01 00 00 00 00 02 DE 57
			29 01 00 00 00 00 02 DF 03
			29 01 00 00 00 00 02 E0 6B
			29 01 00 00 00 00 02 E1 03
			29 01 00 00 00 00 02 E2 7C
			29 01 00 00 00 00 02 E3 03
			29 01 00 00 00 00 02 E4 92
			29 01 00 00 00 00 02 E5 03
			29 01 00 00 00 00 02 E6 AA
			29 01 00 00 00 00 02 E7 03
			29 01 00 00 00 00 02 E8 D9
			29 01 00 00 00 00 02 E9 03
			29 01 00 00 00 00 02 EA DB
			29 01 00 00 00 00 02 FF 00
			29 01 00 00 00 00 02 FB 01
			29 01 00 00 00 00 02 C2 03
			29 01 00 00 00 00 02 BA 03
			39 01 00 00 0A 00 02 51 00
			39 01 00 00 00 00 02 53 24
			39 01 00 00 00 00 02 55 01
			05 01 00 00 78 00 02 11 00
			05 01 00 00 16 00 02 29 00];
		qcom,mdss-dsi-off-command = [05 01 00 00 32 00 02 28 00
			05 01 00 00 78 00 02 10 00];
		qcom,mdss-dsi-on-command-state = "dsi_lp_mode";
		qcom,mdss-dsi-off-command-state = "dsi_lp_mode";
		qcom,mdss-dsi-h-sync-pulse = <1>;
		qcom,mdss-dsi-traffic-mode = <2>;
		qcom,mdss-dsi-lane-map = <0>;
		qcom,mdss-dsi-bllp-eof-power-mode;
		qcom,mdss-dsi-bllp-power-mode;
		qcom,mdss-dsi-lane-0-state;
		qcom,mdss-dsi-lane-1-state;
		qcom,mdss-dsi-lane-2-state;
		qcom,mdss-dsi-lane-3-state;
		qcom,mdss-dsi-panel-timings = [7b 1b 12 00 40 49 17 1e 1e 03 04 00];
		qcom,mdss-dsi-reset-sequence = <1 1>, <0 20>, <1 120>;
		qcom,mdss-dsi-t-clk-post = <0x04>;
		qcom,mdss-dsi-t-clk-pre = <0x19>;
		qcom,mdss-dsi-bl-min-level = <1>;
		qcom,mdss-dsi-bl-max-level = <255>;
		qcom,mdss-dsi-dma-trigger = <4>;
		qcom,mdss-dsi-mdp-trigger = <0>;
		qcom,mdss-dsi-bl-pmic-control-type = "bl_ctrl_dcs";
		qcom,panel-cabc-ui-cmds = [15 01 00 00 00 00 02 55 01
					15 01 00 00 00 00 02 53 24];
		qcom,panel-cabc-video-cmds = [15 01 00 00 00 00 02 55 03
					15 01 00 00 00 00 02 53 2C];
		qcom,panel-dot-inversion-mode-cmds = [29 01 00 00 00 00 02 22 00
				29 01 00 00 00 00 02 23 01];
		qcom,panel-column-inversion-mode-cmds = [29 01 00 00 00 00 02 22 55
				29 01 00 00 00 00 02 23 0D];
		qcom,cabc-ui-cmds-dsi-state = "dsi_hs_mode";
		qcom,cabc-video-cmds-dsi-state = "dsi_hs_mode";
		qcom,dot-inversion-cmds-dsi-state = "dsi_lp_mode";
		qcom,column-inversion-cmds-dsi-state = "dsi_lp_mode";
		huawei,mdss-dsi-pan-enable-dynamic-fps;
		huawei,bias-ic-enable;
	};
};
