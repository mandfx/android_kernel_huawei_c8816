/*
 * Copyright (c) 2012-2013, The Linux Foundation. All rights reserved.
 *
 * This program is free software; you can redistribute it and/or modify
 * it under the terms of the GNU General Public License version 2 and
 * only version 2 as published by the Free Software Foundation.
 *
 * This program is distributed in the hope that it will be useful,
 * but WITHOUT ANY WARRANTY; without even the implied warranty of
 * MERCHANTABILITY or FITNESS FOR A PARTICULAR PURPOSE.  See the
 * GNU General Public License for more details.
 */
/*YUV sensor, remove af and flash*/
&i2c {
	//Added for 23060073 3M Sunny s5k5cagx_yuv
	qcom,camera@5a {
		compatible = "qcom,s5k5cagx";
		reg = <0x5a>;
		qcom,slave-id = <0x5a 0x0040 0x05CA>;
		qcom,csiphy-sd-index = <0>;
		qcom,csid-sd-index = <0>;

		qcom,mount-angle = <90>;
		qcom,sensor-name = "s5k5cagx";
		cam_vdig-supply = <&pm8110_l7>;
		cam_vio-supply = <&pm8110_l7>;
		cam_vana-supply = <&pm8110_l22>;
		qcom,cam-vreg-name = "cam_vdig", "cam_vio", "cam_vana";
		qcom,cam-vreg-type = <0 0 0>;
		qcom,cam-vreg-min-voltage = <1800000 1800000 2850000>;
		qcom,cam-vreg-max-voltage = <1800000 1800000 2850000>;
		qcom,cam-vreg-op-mode = <200000 200000 100000>;
		qcom,gpio-no-mux = <0>;
		gpios = <&msmgpio 13 0>,//mclk
			<&msmgpio 21 0>,//reset
			<&msmgpio 20 0>;//stanby
		qcom,gpio-reset = <1>;
		qcom,gpio-standby = <2>;
		qcom,gpio-req-tbl-num = <0 1 2>;
		qcom,gpio-req-tbl-flags = <1 0 0>;
		qcom,gpio-req-tbl-label = "CAMIF_MCLK",
			"CAM_RESET",
			"CAM_STANDBY";
		qcom,csi-lane-assign = <0xe4>;
		qcom,csi-lane-mask = <0x7>;
		qcom,sensor-position = <0>;
		qcom,sensor-mode = <0>;
		qcom,cci-master = <0>;
	};
	qcom,camera@40 {
		compatible = "qcom,hi258";
		reg = <0x40>;
		qcom,slave-id = <0x40 0x04 0xD1>;
		qcom,csiphy-sd-index = <0>;
		qcom,csid-sd-index = <0>;
		qcom,mount-angle = <90>;
		qcom,sensor-name = "hi258";
		cam_vdig-supply = <&pm8110_l7>;
		cam_vio-supply = <&pm8110_l7>;
		cam_vana-supply = <&pm8110_l22>;
		qcom,cam-vreg-name = "cam_vdig", "cam_vio", "cam_vana";
		qcom,cam-vreg-type = <0 0 0>;
		qcom,cam-vreg-min-voltage = <1800000 1800000 2850000>;
		qcom,cam-vreg-max-voltage = <1800000 1800000 2850000>;
		qcom,cam-vreg-op-mode = <200000 200000 100000>;
		qcom,gpio-no-mux = <0>;
		gpios = <&msmgpio 13 0>,
			<&msmgpio 21 0>,
			<&msmgpio 20 0>;
		qcom,gpio-reset = <1>;
		qcom,gpio-standby = <2>;
		qcom,gpio-req-tbl-num = <0 1 2>;
		qcom,gpio-req-tbl-flags = <1 0 0>;
		qcom,gpio-req-tbl-label = "CAMIF_MCLK",
					"CAM_RESET",
					"CAM_STANDBY";
		qcom,csi-lane-assign = <0xe4>;
		qcom,csi-lane-mask = <0x7>;
		qcom,sensor-position = <0>;
		qcom,sensor-mode = <0>;
		qcom,cci-master = <0>;
	};
	
	qcom,camera@26 {
		compatible = "qcom,ov2685";
		reg = <0x26>;
		qcom,slave-id = <0x20 0x300a 0x26>;
		qcom,csiphy-sd-index = <0>;
		qcom,csid-sd-index = <0>;
		qcom,mount-angle = <90>;
		qcom,sensor-name = "ov2685";
		cam_vdig-supply = <&pm8110_l7>;
		cam_vio-supply = <&pm8110_l7>;
		cam_vana-supply = <&pm8110_l22>;
		qcom,cam-vreg-name = "cam_vdig", "cam_vio", "cam_vana";
		qcom,cam-vreg-type = <0 0 0>;
		qcom,cam-vreg-min-voltage = <0 1800000 2850000>;
		qcom,cam-vreg-max-voltage = <0 1800000 2850000>;
		qcom,cam-vreg-op-mode = <0 200000 100000>;
		qcom,gpio-no-mux = <0>;
		gpios = <&msmgpio 13 0>,
			<&msmgpio 21 0>,
			<&msmgpio 20 0>;
		qcom,gpio-reset = <1>;
		qcom,gpio-standby = <2>;
		qcom,gpio-req-tbl-num = <0 1 2>;
		qcom,gpio-req-tbl-flags = <1 0 0>;
		qcom,gpio-req-tbl-label = "CAMIF_MCLK",
					"CAM_RESET",
					"CAM_STANDBY";
		qcom,csi-lane-assign = <0xe4>;
		qcom,csi-lane-mask = <0x7>;
		qcom,sensor-position = <0>;
		qcom,sensor-mode = <0>;
		qcom,cci-master = <0>;
	};
	
};
