 / {
        huawei_fac_info {
                  compatible = "huawei,hw_fac_info";
                  fac,product_name = "Y330_C00";
                  fac,hardware_ver = "HC1Y330TM_VERA";
		  fac,software_ver = "MSM8x10_Y330_C00_va";
                  status = "ok";
        };
};
